## conf/layer.conf
```bitbake
# We have a conf and classes directory, add to BBPATH
BBPATH .= ":${LAYERDIR}"

# We have a packages directory, add to BBFILES
BBFILES += "${LAYERDIR}/recipes-*/*/*.bb \
            ${LAYERDIR}/recipes-*/*/*.bbappend"

BBFILE_COLLECTIONS += "toradex-extra"
BBFILE_PATTERN_toradex-extra := "^${LAYERDIR}/"
BBFILE_PRIORITY_toradex-extra = "5"

LAYERDEPENDS_toradex-extra = "core fsl-arm fsl-arm-extra"
```
